## board/embeddedts/ts4100/Kconfig
```kconfig
if TARGET_EMBEDDEDTS_TS4100

config SYS_BOARD
	default "ts4100"

config SYS_VENDOR
	default "embeddedts"

config SYS_SOC
	default "mx6"

config SYS_CONFIG_NAME
	default "ts4100"

endif
```

## board/embeddedts/ts4900/Kconfig
```kconfig
if TARGET_EMBEDDEDTS_TS4900

config SYS_BOARD
	default "ts4900"

config SYS_VENDOR
	default "embeddedts"

config SYS_CONFIG_NAME
	default "ts4900"

config SYS_SPI_SPL_OFFS
	hex "SPL offset in SPI NOR flash"
	default 0x400
	help
	  Offset of SPL in SPI NOR flash. NOTE WELL! This should never need
	  to change and is provided for completeness.

config SYS_SPI_FPGA_OFFS
	hex "FPGA bitstream offset in NOR flash"
	default 0xc0000
	help
	  Offset of the FPGA bitstream in SPI NOR flash. Normally, one would
	  want to use binman runtime symbols. However there is an incompatibility
	  in getting these symbols patched in to the runtime SPL due to the build
	  process. Binman patches u-boot-spl, but does not regenerate the i.MX
	  format SPL file. So the final binman packed image uses the SPL file
	  with invalid binman symbol references.

	  This option helps us place the FPGA bitstream in a way that SPL can
	  still have this information while also letting binman be able to raise
	  alarms if the file is encroached on.

config SYS_SPI_FPGA_LEN
	hex "FPGA bitstream length in NOR flash"
	default 0x1cf72
	help
	  Length of the FPGA bitstream in SPI NOR flash. As with the OFFS above,
	  binman is the correct way to do this but that has its own issues.

	  Instead, the default length here should always be correct and never
	  need to change.

	  The binman output is set up such that this will always align to the
	  same sector alignment as the environment (which is always assumed to
	  be some multiple of the erase block size of SPI) to ensure proper
	  alignment of all binaries no matter where they end up.

endif
```

## board/embeddedts/ts7100/Kconfig
```kconfig
if TARGET_EMBEDDEDTS_TS7100

config SYS_BOARD
	default "ts7100"

config SYS_VENDOR
	default "embeddedts"

config SYS_CONFIG_NAME
	default "ts7100"
	help
	  This board uses an i.MX6UL SoC and boots from eMMC using SPL.

endif
```

## board/embeddedts/ts7180/Kconfig
```kconfig
if TARGET_EMBEDDEDTS_TS7180

config SYS_BOARD
	default "ts7180"

config SYS_VENDOR
	default "embeddedts"

config SYS_CONFIG_NAME
	default "ts7180"
	help
	  This board uses an i.MX6UL SoC and boots from eMMC or SD using SPL.

endif
```

## board/embeddedts/ts7250v3/Kconfig
```kconfig
if TARGET_EMBEDDEDTS_TS7250V3

config SYS_BOARD
	default "ts7250v3"

config SYS_VENDOR
	default "embeddedts"

config SYS_CONFIG_NAME
	default "ts7250v3"

endif
```

## board/embeddedts/ts7553v2/Kconfig
```kconfig
if TARGET_EMBEDDEDTS_TS7553V2

config SYS_BOARD
	default "ts7553v2"

config SYS_VENDOR
	default "embeddedts"

config SYS_SOC
	default "mx6"

config SYS_CONFIG_NAME
	default "ts7553v2"

endif
```

## configs/ts4100_512m_defconfig
```kconfig
CONFIG_ARM=y
CONFIG_ARCH_MX6=y
CONFIG_MX6UL=y
CONFIG_TEXT_BASE=0x87800000
CONFIG_TARGET_EMBEDDEDTS_TS4100=y
CONFIG_DEFAULT_DEVICE_TREE="imx6ul-ts4100"
CONFIG_IMX_CONFIG="board/embeddedts/ts4100/imximage-512m.cfg"
CONFIG_NR_DRAM_BANKS=1
CONFIG_ENV_SIZE=0x20000
CONFIG_ENV_OFFSET=0x400000
CONFIG_ENV_OFFSET_REDUND=0x600000
CONFIG_ENV_REDUNDANT=y
CONFIG_ENV_MMC_DEVICE_INDEX=1
CONFIG_ENV_MMC_EMMC_HW_PARTITION=1
CONFIG_BOOTSTD_FULL=y
CONFIG_EFI_LOADER=y
CONFIG_EFI_PARTITION=y
# Capsule creation is a host-side packaging tool and needs GnuTLS headers.
# EFI boot and signed FIT support do not depend on capsule updates.
# CONFIG_TOOLS_MKEFICAPSULE is not set
CONFIG_FIT=y
CONFIG_FIT_SIGNATURE=y
CONFIG_BOOTDELAY=1
CONFIG_SYS_CONSOLE_IS_IN_ENV=y
CONFIG_BOARD_EARLY_INIT_F=y
CONFIG_CMD_GPIO=y
CONFIG_CMD_GPT=y
CONFIG_CMD_I2C=y
CONFIG_CMD_MMC=y
CONFIG_CMD_USB=y
CONFIG_CMD_DHCP=y
CONFIG_CMD_MII=y
CONFIG_CMD_PING=y
CONFIG_CMD_CACHE=y
CONFIG_CMD_EXT4=y
CONFIG_CMD_FAT=y
CONFIG_CMD_FS_GENERIC=y
CONFIG_OF_CONTROL=y
CONFIG_DM=y
CONFIG_DM_ETH=y
CONFIG_DM_MDIO=y
CONFIG_DM_ETH_PHY=y
CONFIG_DM_GPIO=y
CONFIG_DM_I2C=y
CONFIG_DM_MMC=y
CONFIG_DM_REGULATOR=y
CONFIG_DM_REGULATOR_FIXED=y
CONFIG_DM_SERIAL=y
CONFIG_DM_THERMAL=y
CONFIG_FSL_USDHC=y
CONFIG_MXC_UART=y
CONFIG_NET_RANDOM_ETHADDR=y
CONFIG_FEC_MXC=y
CONFIG_MII=y
CONFIG_PHYLIB=y
CONFIG_PHY_MICREL=y
CONFIG_PHY_MICREL_KSZ8XXX=y
CONFIG_PINCTRL=y
CONFIG_PINCTRL_IMX6=y
CONFIG_SUPPORT_EMMC_BOOT=y
CONFIG_USB=y
CONFIG_DM_USB=y
CONFIG_USB_EHCI_MX6=y
CONFIG_USB_STORAGE=y
CONFIG_ENV_IS_IN_MMC=y
CONFIG_SYS_PROMPT="TS-4100 # "
```

## configs/ts4100_defconfig
```kconfig
CONFIG_ARM=y
CONFIG_ARCH_MX6=y
CONFIG_MX6UL=y
CONFIG_TEXT_BASE=0x87800000
CONFIG_TARGET_EMBEDDEDTS_TS4100=y
CONFIG_DEFAULT_DEVICE_TREE="imx6ul-ts4100"
CONFIG_IMX_CONFIG="board/embeddedts/ts4100/imximage.cfg"
CONFIG_SPL=y
CONFIG_SPL_GPIO=y
CONFIG_SPL_LIBCOMMON_SUPPORT=y
CONFIG_SPL_LIBGENERIC_SUPPORT=y
CONFIG_SPL_MMC=y
CONFIG_SPL_I2C=y
CONFIG_SPL_RAW_IMAGE_SUPPORT=y
CONFIG_SPL_SERIAL=y
CONFIG_SPL_SYS_I2C_LEGACY=y
CONFIG_SPL_BSS_START_ADDR=0x00920000
CONFIG_SPL_SYS_MALLOC_F_LEN=0x4000
CONFIG_SYS_MMCSD_RAW_MODE_U_BOOT_SECTOR=0x8a
CONFIG_WATCHDOG_TIMEOUT_MSECS=60000
CONFIG_WATCHDOG=y
CONFIG_WATCHDOG_AUTOSTART=y
CONFIG_SYSRESET=y
CONFIG_SYSRESET_CMD_RESET=y
CONFIG_SYSRESET_WATCHDOG=y
CONFIG_SYSRESET_WATCHDOG_AUTO=y
CONFIG_SYS_MONITOR_LEN=786432
CONFIG_NR_DRAM_BANKS=1
CONFIG_ENV_SIZE=0x20000
CONFIG_ENV_OFFSET=0x100000
CONFIG_ENV_OFFSET_REDUND=0x180000
CONFIG_ENV_REDUNDANT=y
CONFIG_ENV_MMC_DEVICE_INDEX=1
CONFIG_ENV_MMC_EMMC_HW_PARTITION=1
CONFIG_BOOTSTD_FULL=y
CONFIG_EFI_LOADER=y
CONFIG_EFI_PARTITION=y
# Capsule creation is a host-side packaging tool and needs GnuTLS headers.
# EFI boot and signed FIT support do not depend on capsule updates.
# CONFIG_TOOLS_MKEFICAPSULE is not set
CONFIG_FIT=y
CONFIG_FIT_SIGNATURE=y
CONFIG_BOOTDELAY=1
CONFIG_SYS_CONSOLE_IS_IN_ENV=y
CONFIG_BOARD_EARLY_INIT_F=y
CONFIG_CMD_GPIO=y
CONFIG_CMD_GPT=y
CONFIG_CMD_I2C=y
CONFIG_CMD_MMC=y
CONFIG_CMD_USB=y
CONFIG_CMD_FASTBOOT=y
CONFIG_CMD_DHCP=y
CONFIG_CMD_WGET=y
CONFIG_DNS=y
CONFIG_PROT_TCP_SACK=y
CONFIG_TCP_FUNCTION_FASTBOOT=y
CONFIG_CMD_BOOTZ=y
CONFIG_CMD_MII=y
CONFIG_CMD_PING=y
CONFIG_CMD_CACHE=y
CONFIG_CMD_WDT=y
CONFIG_CMD_EXT4=y
CONFIG_CMD_FAT=y
CONFIG_CMD_FS_GENERIC=y
CONFIG_OF_CONTROL=y
CONFIG_DM=y
CONFIG_DM_ETH=y
CONFIG_DM_MDIO=y
CONFIG_DM_ETH_PHY=y
CONFIG_DM_GPIO=y
CONFIG_DM_I2C=y
CONFIG_DM_MMC=y
CONFIG_DM_REGULATOR=y
CONFIG_DM_REGULATOR_FIXED=y
CONFIG_DM_SERIAL=y
CONFIG_DM_THERMAL=y
CONFIG_FSL_USDHC=y
CONFIG_MXC_UART=y
CONFIG_NET_RANDOM_ETHADDR=y
CONFIG_FEC_MXC=y
CONFIG_MII=y
CONFIG_PHYLIB=y
CONFIG_PHY_MICREL=y
CONFIG_PHY_MICREL_KSZ8XXX=y
CONFIG_PINCTRL=y
CONFIG_PINCTRL_IMX6=y
CONFIG_SUPPORT_EMMC_BOOT=y
CONFIG_IMX_WATCHDOG=y
CONFIG_WDT=y
CONFIG_FASTBOOT=y
CONFIG_FASTBOOT_UUU_SUPPORT=y
CONFIG_FASTBOOT_BUF_ADDR=0x82000000
CONFIG_FASTBOOT_BUF_SIZE=0x7000000
CONFIG_FASTBOOT_FLASH=y
CONFIG_FASTBOOT_FLASH_MMC=y
CONFIG_FASTBOOT_FLASH_MMC_DEV=1
CONFIG_FASTBOOT_MMC_BOOT_SUPPORT=y
CONFIG_FASTBOOT_MMC_BOOT1_NAME="mmc1boot0"
CONFIG_FASTBOOT_MMC_BOOT2_NAME="mmc1boot1"
CONFIG_FASTBOOT_MMC_USER_SUPPORT=y
CONFIG_FASTBOOT_MMC_USER_NAME="mmc1"
CONFIG_USB_FUNCTION_FASTBOOT=y
CONFIG_USB_GADGET=y
CONFIG_USB_GADGET_MANUFACTURER="FSL"
CONFIG_USB_GADGET_VENDOR_NUM=0x0525
CONFIG_USB_GADGET_PRODUCT_NUM=0xa4a5
CONFIG_CI_UDC=y
CONFIG_USB_GADGET_DOWNLOAD=y
CONFIG_SPL_USB_GADGET=y
CONFIG_SPL_USB_HOST=y
CONFIG_SPL_USB_SDP_SUPPORT=y
CONFIG_USB=y
CONFIG_DM_USB=y
CONFIG_USB_EHCI_MX6=y
CONFIG_USB_STORAGE=y
CONFIG_ENV_IS_IN_MMC=y
CONFIG_SYS_I2C_MXC=y
CONFIG_SYS_I2C_MXC_I2C3=y
CONFIG_DISPLAY_CPUINFO=y
# CONFIG_SYS_CONSOLE_INFO_QUIET is not set
```

## configs/ts4900_defconfig
```kconfig
CONFIG_ARM=y
CONFIG_ARCH_MX6=y
CONFIG_SYS_MALLOC_LEN=0xa00000
CONFIG_SYS_MALLOC_F_LEN=0x4000
CONFIG_SPL_GPIO=y
CONFIG_SPL_LIBCOMMON_SUPPORT=y
CONFIG_SPL_LIBGENERIC_SUPPORT=y
CONFIG_NR_DRAM_BANKS=1
CONFIG_SF_DEFAULT_SPEED=25000000
CONFIG_ENV_SIZE=0x10000
CONFIG_ENV_OFFSET=0xe0000
CONFIG_ENV_SECT_SIZE=0x10000
CONFIG_MX6QDL=y
CONFIG_TARGET_EMBEDDEDTS_TS4900=y
CONFIG_SYS_I2C_MXC_I2C1=y
CONFIG_DM_GPIO=y
CONFIG_DEFAULT_DEVICE_TREE="imx6q-ts4900"
CONFIG_DM_RESET=y
CONFIG_SYS_MONITOR_LEN=409600
CONFIG_SPL_SERIAL=y
CONFIG_SPL=y
CONFIG_ENV_OFFSET_REDUND=0xf0000
CONFIG_SPL_SPI_FLASH_SUPPORT=y
CONFIG_SPL_SPI=y
CONFIG_NXP_BOARD_REVISION=y
CONFIG_FIT=y
CONFIG_SPL_FIT_PRINT=y
CONFIG_SPL_LOAD_FIT=y
CONFIG_SUPPORT_RAW_INITRD=y
CONFIG_OF_BOARD_SETUP=y
# CONFIG_SPL_RAW_IMAGE_SUPPORT is not set
CONFIG_SPL_LEGACY_IMAGE_FORMAT=y
CONFIG_SPL_SYS_MALLOC_SIMPLE=y
CONFIG_SPL_SYS_MALLOC=y
CONFIG_SPL_FIT_IMAGE_TINY=y
CONFIG_SPL_I2C=y
CONFIG_SPL_SPI_LOAD=y
CONFIG_SYS_SPI_U_BOOT_OFFS=0x00020000
CONFIG_SPL_WATCHDOG=y
CONFIG_HUSH_PARSER=y
CONFIG_SYS_MAXARGS=32
CONFIG_CMD_BOOTZ=y
CONFIG_CMD_EXTENSION=y
CONFIG_CMD_GPIO=y
CONFIG_CMD_I2C=y
CONFIG_CMD_MMC=y
CONFIG_CMD_PART=y
CONFIG_CMD_SPI=y
CONFIG_CMD_USB=y
CONFIG_CMD_USB_MASS_STORAGE=y
CONFIG_CMD_WDT=y
CONFIG_SYS_DISABLE_AUTOLOAD=y
CONFIG_CMD_DHCP=y
CONFIG_CMD_MII=y
CONFIG_CMD_PING=y
CONFIG_CMD_WGET=y
CONFIG_CMD_CACHE=y
CONFIG_CMD_REGULATOR=y
CONFIG_CMD_EXT4=y
CONFIG_CMD_FAT=y
CONFIG_CMD_FS_GENERIC=y
# CONFIG_SPL_DOS_PARTITION is not set
CONFIG_EFI_PARTITION=y
# CONFIG_SPL_EFI_PARTITION is not set
CONFIG_OF_CONTROL=y
CONFIG_OF_LIST="imx6q-ts4900 imx6dl-ts4900"
CONFIG_MULTI_DTB_FIT=y
CONFIG_ENV_IS_IN_SPI_FLASH=y
CONFIG_ENV_SPI_MAX_HZ=15000000
CONFIG_ENV_REDUNDANT=y
CONFIG_ENV_RELOC_GD_ENV_ADDR=y
CONFIG_ARP_TIMEOUT=200
CONFIG_NET_RANDOM_ETHADDR=y
CONFIG_DM_I2C=y
CONFIG_SPL_SYS_I2C_LEGACY=y
CONFIG_SYS_I2C_MXC=y
CONFIG_SYS_MXC_I2C1_SLAVE=0x28
CONFIG_LED=y
CONFIG_LED_GPIO=y
CONFIG_FSL_USDHC=y
CONFIG_MTD=y
CONFIG_DM_SPI_FLASH=y
CONFIG_SPI_FLASH_ISSI=y
CONFIG_SPI_FLASH_MACRONIX=y
CONFIG_SPI_FLASH_STMICRO=y
CONFIG_SPI_FLASH_SST=y
# CONFIG_SPI_FLASH_USE_4K_SECTORS is not set
CONFIG_PHYLIB=y
CONFIG_PHY_MICREL=y
CONFIG_PHY_MICREL_KSZ90X1=y
CONFIG_FEC_MXC=y
CONFIG_RGMII=y
CONFIG_MII=y
CONFIG_PINCTRL=y
CONFIG_PINCTRL_IMX6=y
CONFIG_DM_REGULATOR=y
CONFIG_DM_REGULATOR_FIXED=y
CONFIG_DM_SERIAL=y
CONFIG_MXC_UART=y
CONFIG_SPI=y
CONFIG_DM_SPI=y
CONFIG_MXC_SPI=y
CONFIG_SYSRESET=y
CONFIG_SYSRESET_WATCHDOG=y
CONFIG_SYSRESET_WATCHDOG_AUTO=y
CONFIG_IMX_THERMAL=y
CONFIG_USB=y
CONFIG_SPL_USB_HOST=y
CONFIG_USB_MAX_CONTROLLER_COUNT=2
CONFIG_USB_STORAGE=y
CONFIG_USB_GADGET=y
CONFIG_SPL_USB_GADGET=y
CONFIG_USB_GADGET_MANUFACTURER="FSL"
CONFIG_USB_GADGET_VENDOR_NUM=0x0525
CONFIG_USB_GADGET_PRODUCT_NUM=0xa4a5
CONFIG_CI_UDC=y
CONFIG_USB_GADGET_DOWNLOAD=y
CONFIG_SPL_USB_SDP_SUPPORT=y
CONFIG_IMX_WATCHDOG=y
# CONFIG_FAT_WRITE is not set
```

## configs/ts7100_defconfig
```kconfig
CONFIG_ARM=y
CONFIG_ARCH_MX6=y
CONFIG_TEXT_BASE=0x87800000
CONFIG_SPL_GPIO=y
CONFIG_SPL_LIBCOMMON_SUPPORT=y
CONFIG_SPL_LIBGENERIC_SUPPORT=y
CONFIG_NR_DRAM_BANKS=1
CONFIG_ENV_SIZE=0x20000
CONFIG_ENV_OFFSET=0x100000
CONFIG_MX6UL=y
CONFIG_TARGET_EMBEDDEDTS_TS7100=y
CONFIG_DEFAULT_DEVICE_TREE="imx6ul-ts7100"
CONFIG_OF_LIBFDT_OVERLAY=y
CONFIG_SPL_MMC=y
CONFIG_SPL_RAW_IMAGE_SUPPORT=y
CONFIG_SPL_SERIAL=y
CONFIG_SPL_SYS_MALLOC_F_LEN=0x4000
CONFIG_WATCHDOG_TIMEOUT_MSECS=60000
CONFIG_WATCHDOG=y
CONFIG_WATCHDOG_AUTOSTART=y
CONFIG_SYSRESET=y
CONFIG_SYSRESET_CMD_RESET=y
CONFIG_SYSRESET_WATCHDOG=y
CONFIG_SYSRESET_WATCHDOG_AUTO=y
CONFIG_SPL=y
CONFIG_ENV_OFFSET_REDUND=0x180000
CONFIG_SPL_LIBDISK_SUPPORT=y
CONFIG_SYS_MMCSD_RAW_MODE_U_BOOT_SECTOR=0x8a
CONFIG_SYS_MONITOR_LEN=1048576
# CONFIG_ANDROID_BOOT_IMAGE is not set
CONFIG_BOOTSTD_FULL=y
CONFIG_EFI_LOADER=y
CONFIG_EFI_PARTITION=y
CONFIG_FIT=y
CONFIG_FIT_SIGNATURE=y
CONFIG_BOOTDELAY=1
CONFIG_AUTOBOOT_KEYED=y
CONFIG_AUTOBOOT_PROMPT="Press ESC twice to abort autoboot in %d second(s)\n"
CONFIG_AUTOBOOT_STOP_STR="\x1b\x1b"
CONFIG_AUTOBOOT_KEYED_CTRLC=y
CONFIG_OF_BOARD_SETUP=y
CONFIG_SYS_CONSOLE_IS_IN_ENV=y
# CONFIG_DISPLAY_CPUINFO is not set
# CONFIG_DISPLAY_BOARDINFO is not set
CONFIG_DISPLAY_BOARDINFO_LATE=y
CONFIG_BOARD_EARLY_INIT_F=y
CONFIG_CMD_MEMTEST=y
CONFIG_CMD_GPIO=y
CONFIG_CMD_GPT=y
CONFIG_CMD_GPT_RENAME=y
CONFIG_CMD_I2C=y
CONFIG_CMD_MMC=y
CONFIG_CMD_USB=y
CONFIG_CMD_USB_MASS_STORAGE=y
CONFIG_CMD_WDT=y
# CONFIG_CMD_MDIO is not set
CONFIG_CMD_WGET=y
CONFIG_CMD_DHCP=y
CONFIG_CMD_BOOTZ=y
CONFIG_CMD_CACHE=y
CONFIG_CMD_EXT4_WRITE=y
CONFIG_CMD_FS_UUID=y
# CONFIG_SPL_PARTITION_UUIDS is not set
CONFIG_PARTITION_TYPE_GUID=y
CONFIG_OF_CONTROL=y
CONFIG_ENV_IS_IN_MMC=y
CONFIG_ENV_REDUNDANT=y
CONFIG_ENV_RELOC_GD_ENV_ADDR=y
CONFIG_ENV_MMC_DEVICE_INDEX=0
CONFIG_ENV_MMC_EMMC_HW_PARTITION=1
CONFIG_ENV_VARS_UBOOT_RUNTIME_CONFIG=y
CONFIG_VERSION_VARIABLE=y
CONFIG_NET_RANDOM_ETHADDR=y
CONFIG_BOUNCE_BUFFER=y
CONFIG_USB_FUNCTION_FASTBOOT=y
CONFIG_UDP_FUNCTION_FASTBOOT=y
CONFIG_FASTBOOT_FLASH=y
CONFIG_FASTBOOT_FLASH_MMC_DEV=0
CONFIG_FASTBOOT_MMC_BOOT_SUPPORT=y
CONFIG_FASTBOOT_MMC_BOOT1_NAME="mmc0boot0"
CONFIG_FASTBOOT_MMC_BOOT2_NAME="mmc0boot1"
CONFIG_FASTBOOT_MMC_USER_SUPPORT=y
CONFIG_FASTBOOT_MMC_USER_NAME="mmc0"
CONFIG_SYS_I2C_MXC=y
CONFIG_LED_STATUS=y
CONFIG_LED_STATUS0=y
CONFIG_LED_STATUS_BIT=1
CONFIG_LED_STATUS_STATE=2
CONFIG_LED_STATUS1=y
CONFIG_LED_STATUS_BIT1=2
CONFIG_LED_STATUS2=y
CONFIG_LED_STATUS_BIT2=3
CONFIG_LED_STATUS3=y
CONFIG_LED_STATUS_BIT3=4
CONFIG_LED_STATUS_RED_ENABLE=y
CONFIG_LED_STATUS_RED=0
CONFIG_LED_STATUS_GREEN_ENABLE=y
CONFIG_LED_STATUS_GREEN=1
CONFIG_LED_STATUS_CMD=y
CONFIG_SUPPORT_EMMC_BOOT=y
CONFIG_FSL_USDHC=y
CONFIG_PHYLIB=y
CONFIG_PHY_MICREL=y
CONFIG_PHY_MICREL_KSZ8XXX=y
CONFIG_FEC_MXC_SHARE_MDIO=y
CONFIG_FEC_MXC_MDIO_BASE=0x2188000
CONFIG_FEC_MXC=y
CONFIG_MII=y
CONFIG_PINCTRL=y
CONFIG_PINCTRL_IMX6=y
CONFIG_DM_REGULATOR=y
CONFIG_DM_REGULATOR_FIXED=y
CONFIG_DM_REGULATOR_GPIO=y
CONFIG_USB=y
CONFIG_SPL_USB_HOST=y
CONFIG_USB_GADGET=y
CONFIG_SPL_USB_GADGET=y
CONFIG_USB_GADGET_MANUFACTURER="FSL"
CONFIG_USB_GADGET_VENDOR_NUM=0x0525
CONFIG_USB_GADGET_PRODUCT_NUM=0xa4a5
CONFIG_CI_UDC=y
CONFIG_SPL_USB_SDP_SUPPORT=y
CONFIG_USB_FUNCTION_THOR=y
CONFIG_IMX_WATCHDOG=y
CONFIG_WDT=y
# CONFIG_TOOLS_MKEFICAPSULE is not set

CONFIG_MTD=y
CONFIG_DM_SPI_FLASH=y
CONFIG_SF_DEFAULT_MODE=0
CONFIG_SF_DEFAULT_SPEED=40000000
CONFIG_SPI_FLASH_STMICRO=y
CONFIG_DM_RESET=y
CONFIG_SPI=y
CONFIG_DM_SPI=y
CONFIG_SOFT_SPI=y
CONFIG_FSL_QSPI=y
CONFIG_MXC_SPI=y
CONFIG_IMX_THERMAL=y
```
