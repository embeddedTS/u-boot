## board/technologic/ngmini/Kconfig
```kconfig
if TARGET_NGMINI

config SYS_BOARD
	default "ngmini"

config SYS_VENDOR
	default "technologic"

config SYS_SOC
	default "mxs"

config SYS_CONFIG_NAME
	default "ngmini"

endif
```

## board/technologic/sage/Kconfig
```kconfig
if TARGET_SAGE

config SYS_BOARD
	default "sage"

config SYS_VENDOR
	default "technologic"

config SYS_SOC
	default "mxs"

config SYS_CONFIG_NAME
	default "sage"

endif
```

## board/technologic/trafficnet/Kconfig
```kconfig
if TARGET_TRAFFICNET

config SYS_BOARD
	default "trafficnet"

config SYS_VENDOR
	default "technologic"

config SYS_SOC
	default "mxs"

config SYS_CONFIG_NAME
	default "trafficnet"

endif
```

## board/technologic/ts4900/Kconfig
```kconfig
if TARGET_TS4900

config SYS_BOARD
	default "ts4900"

config SYS_VENDOR
	default "technologic"

config SYS_SOC
	default "mx6"

config SYS_CONFIG_NAME
	default "ts4900"

endif
```

## board/technologic/ts7400_V2/Kconfig
```kconfig
if TARGET_TS7400_V2

config SYS_BOARD
	default "ts7400_V2"

config SYS_VENDOR
	default "technologic"

config SYS_SOC
	default "mxs"

config SYS_CONFIG_NAME
	default "ts7400_V2"

endif
```

## board/technologic/ts7553/Kconfig
```kconfig
if TARGET_TS7553

config SYS_BOARD
	default "ts7553"

config SYS_VENDOR
	default "technologic"

config SYS_SOC
	default "mxs"

config SYS_CONFIG_NAME
	default "ts7553"

endif
```

## board/technologic/ts7670/Kconfig
```kconfig
if TARGET_TS7670

config SYS_BOARD
	default "ts7670"

config SYS_VENDOR
	default "technologic"

config SYS_SOC
	default "mxs"

config SYS_CONFIG_NAME
	default "ts7670"

endif
```

## board/technologic/ts7680/Kconfig
```kconfig
if TARGET_TS7680

config SYS_BOARD
	default "ts7680"

config SYS_VENDOR
	default "technologic"

config SYS_SOC
	default "mxs"

config SYS_CONFIG_NAME
	default "ts7680"

endif
```

## board/technologic/ts7695/Kconfig
```kconfig
if TARGET_TS7695

config SYS_BOARD
	default "ts7695"

config SYS_VENDOR
	default "technologic"

config SYS_SOC
	default "mxs"

config SYS_CONFIG_NAME
	default "ts7695"

endif
```

## board/technologic/ts7970/Kconfig
```kconfig
if TARGET_TS7970

config SYS_BOARD
	default "ts7970"

config SYS_VENDOR
	default "technologic"

config SYS_SOC
	default "mx6"

config SYS_CONFIG_NAME
	default "ts7970"

endif
```

## board/technologic/ts7990/Kconfig
```kconfig
if TARGET_TS7990

config SYS_BOARD
	default "ts7990"

config SYS_VENDOR
	default "technologic"

config SYS_SOC
	default "mx6"

config SYS_CONFIG_NAME
	default "ts7990"

endif
```

## configs/ts4900-q-2g-1000mhz-c_defconfig
```kconfig
CONFIG_SYS_EXTRA_OPTIONS="IMX_CONFIG=board/technologic/ts4900/ddrsetup/ts4900-q-2g-1000mhz-c.cfg,MX6Q,DDR_MB=2048"
CONFIG_ARM=y
CONFIG_TARGET_TS4900=y
```

## configs/ts4900-s-1g-1000mhz-c-2_defconfig
```kconfig
CONFIG_SYS_EXTRA_OPTIONS="IMX_CONFIG=board/technologic/ts4900/ddrsetup/ts4900-s-1g-1000mhz-c-2.cfg,MX6S,DDR_MB=1024,IMX_TYPE=\"ts4900-s-1g-1000mhz-c-2\""
CONFIG_ARM=y
CONFIG_TARGET_TS4900=y
```

## configs/ts4900-s-1g-800mhz-i_defconfig
```kconfig
CONFIG_ARM=y
CONFIG_ARCH_MX6=y
CONFIG_TARGET_TS4900=y
CONFIG_SYS_EXTRA_OPTIONS="IMX_CONFIG=board/technologic/ts4900/ts4900-s-1g-800mhz-i.cfg,MX6DL,DDR_MB=1024"
CONFIG_FASTBOOT=y
CONFIG_HUSH_PARSER=y
CONFIG_USB_FUNCTION_FASTBOOT=y
CONFIG_CMD_FASTBOOT=y
CONFIG_FASTBOOT_BUF_ADDR=0x12000000
CONFIG_CMD_BOOTM=y
CONFIG_CMD_BOOTZ=y
CONFIG_CMD_MEMTEST=y
CONFIG_CMD_FUSE=y
CONFIG_CMD_GPIO=y
CONFIG_CMD_I2C=y
CONFIG_CMD_MMC=y
CONFIG_CMD_SF=y
CONFIG_CMD_USB=y
CONFIG_CMD_USB_MASS_STORAGE=y
CONFIG_CMD_DHCP=y
CONFIG_CMD_MII=y
CONFIG_CMD_PING=y
CONFIG_CMD_CACHE=y
CONFIG_CMD_TIME=ys
CONFIG_CMD_EXT2=y
CONFIG_CMD_EXT4=y
CONFIG_CMD_EXT4_WRITE=y
CONFIG_CMD_FAT=y
CONFIG_FAT_WRITE=y
CONFIG_CMD_FS_GENERIC=y
CONFIG_VERSION_VARIABLE=y
CONFIG_ENV_IS_IN_SPI_FLASH=y
CONFIG_SPI_FLASH=y
CONFIG_SPI_FLASH_STMICRO=y
CONFIG_PHYLIB=y
CONFIG_PHY_MICREL=y
CONFIG_PHY_MICREL_KSZ90X1=y
CONFIG_NETDEVICES=y
CONFIG_USB=y
CONFIG_USB_STORAGE=y
CONFIG_SYS_USB_EVENT_POLL_VIA_CONTROL_EP=y
CONFIG_USB_GADGET=y
CONFIG_CI_UDC=y
CONFIG_USB_GADGET_DOWNLOAD=y
CONFIG_G_DNL_MANUFACTURER="Technologic"
CONFIG_G_DNL_VENDOR_NUM=0x0525
CONFIG_G_DNL_PRODUCT_NUM=0xa4a5
CONFIG_OF_LIBFDT=y
CONFIG_CMD_FPGA=y
CONFIG_FPGA_LATTICE=y
CONFIG_LED_STATUS=y
CONFIG_LED_STATUS_GPIO=y
CONFIG_LED_STATUS_CMD=y
CONFIG_LED_STATUS0=y
CONFIG_LED_STATUS_BIT=56
CONFIG_STATUS_LED_STATE0=0
CONFIG_LED_STATUS1=y
CONFIG_LED_STATUS_BIT1=1
CONFIG_STATUS_LED_STATE1=2
CONFIG_SYS_THUMB_BUILD=y
CONFIG_BOOTDELAY=1
CONFIG_AUTOBOOT_KEYED=y
CONFIG_AUTOBOOT_PROMPT="Press ESC twice to abort autoboot in %d second(s)\n"
CONFIG_AUTOBOOT_KEYED_CTRLC=y
CONFIG_AUTOBOOT_STOP_STR="\x1b\x1b"
CONFIG_OF_LIBFDT=y
```

## configs/ts4900-s-2g-800mhz-i_defconfig
```kconfig
CONFIG_SYS_EXTRA_OPTIONS="IMX_CONFIG=board/technologic/ts4900/ddrsetup/ts4900-s-2g-800mhz-i.cfg,MX6S,DDR_MB=2048,IMX_TYPE=\"ts4900-s-2g-800mhz-i\""
CONFIG_ARM=y
CONFIG_TARGET_TS4900=y
```

## configs/ts7695_defconfig
```kconfig
CONFIG_SPL=y
CONFIG_SYS_EXTRA_OPTIONS="ENV_IS_IN_MMC"
+S:CONFIG_ARM=y
+S:CONFIG_TARGET_TS7695=y
```

## configs/ts7970-q-2g-1000mhz-c_defconfig
```kconfig
CONFIG_SYS_EXTRA_OPTIONS="IMX_CONFIG=board/technologic/ts7970/ddrsetup/ts7970-q-2g-1000mhz-c.cfg,MX6Q,DDR_MB=2048,IMX_TYPE=\"ts7970-q-2g-1000mhz-c\""
CONFIG_ARM=y
CONFIG_TARGET_TS7970=y
```

## configs/ts7970-s-1g-1000mhz-c_defconfig
```kconfig
CONFIG_SYS_EXTRA_OPTIONS="IMX_CONFIG=board/technologic/ts7970/ddrsetup/ts7970-s-1g-1000mhz-c.cfg,MX6S,DDR_MB=1024"
CONFIG_ARM=y
CONFIG_TARGET_TS7970=y
```

## configs/ts7970-s-1g-800mhz-i_defconfig
```kconfig
CONFIG_SYS_EXTRA_OPTIONS="IMX_CONFIG=board/technologic/ts7970/ddrsetup/ts7970-s-1g-800mhz-i.cfg,MX6S,DDR_MB=1024,IMX_TYPE=\"ts7970-s-1g-800mhz-i\""
CONFIG_ARM=y
CONFIG_TARGET_TS7970=y
```

## configs/ts7970-s-512m-1000mhz-c_defconfig
```kconfig
CONFIG_SYS_EXTRA_OPTIONS="IMX_CONFIG=board/technologic/ts7970/ddrsetup/ts7970-s-512m-1000mhz-c.cfg,MX6S,DDR_MB=512,IMX_TYPE=\"ts7970-s-512m-1000mhz-c\""
CONFIG_ARM=y
CONFIG_TARGET_TS7970=y
```

## configs/ts7990-q-1g-1000mhz-c_defconfig
```kconfig
CONFIG_SYS_EXTRA_OPTIONS="IMX_CONFIG=board/technologic/ts7990/ddrsetup/ts7990-q-1g-1000mhz-c.cfg,MX6Q,DDR_MB=1024,IMX_TYPE=\"ts7990-q-1g-1000mhz-c\""
CONFIG_ARM=y
CONFIG_TARGET_TS7990=y
```

## configs/ts7990-s-1g-800mhz-i_defconfig
```kconfig
CONFIG_SYS_EXTRA_OPTIONS="IMX_CONFIG=board/technologic/ts7990/ddrsetup/ts7990-s-1g-800mhz-i.cfg,MX6S,DDR_MB=1024,IMX_TYPE=\"ts7990-s-1g-800mhz-i\""
CONFIG_ARM=y
CONFIG_TARGET_TS7990=y
```
