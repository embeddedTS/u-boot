## configs/ts7990-s-512m-1000mhz-c_defconfig
```kconfig
CONFIG_SYS_EXTRA_OPTIONS="IMX_CONFIG=board/technologic/ts7990/ddrsetup/ts7990-s-512m-1000mhz-c.cfg,MX6S,DDR_MB=512,IMX_TYPE=\"ts7990-s-512m-1000mhz-c\""
CONFIG_ARM=y
CONFIG_TARGET_TS7990=y
```
